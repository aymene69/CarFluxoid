## os/Config.in
```kconfig
menu "CarFluxoidOS"
source "$BR2_EXTERNAL_CARFLUXOID_PATH/package/aa-bulk/Config.in"
endmenu
```

## os/package/aa-bulk/Config.in
```kconfig
config BR2_PACKAGE_AA_BULK
	bool "aa_bulk kernel module"
	depends on BR2_LINUX_KERNEL
	help
	  CarFluxoid USB High-Speed Android Auto AOA bulk gadget driver
	  with prequeued RX FIFO (aa_bulk.ko).
```
